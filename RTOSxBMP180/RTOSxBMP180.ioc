# file: RTOSxBMP180.ioc
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FREERTOS.Tasks01=defaultTask,0,128,StartDefaultTask,Default,NULL,Dynamic,NULL,NULL
Mcu.Family=STM32F1
Mcu.Name=STM32F103C(8-B)Tx
Mcu.Package=LQFP48
NVIC.PriorityGroup=NVIC_PRIORITYGROUP_4
PA13.Mode=Serial_Wire
PA13.Signal=SYS_JTMS-SWDIO
PA14.Mode=Serial_Wire
PA14.Signal=SYS_JTCK-SWCLK
PD0-OSC_IN.Mode=HSE-External-Oscillator
PD0-OSC_IN.Signal=RCC_OSC_IN
PD1-OSC_OUT.Mode=HSE-External-Oscillator
PD1-OSC_OUT.Signal=RCC_OSC_OUT
ProjectManager.HeapSize=0x200
ProjectManager.StackSize=0x400
ProjectManager.TargetToolchain=STM32CubeIDE
RCC.APB1Freq_Value=8000000
RCC.APB2Freq_Value=8000000
VP_FREERTOS_VS_CMSIS_V1.Mode=CMSIS_V1
board=custom

// file: Core/Src/main.c
/* USER CODE BEGIN Header */
/**
  ******************************************************************************
  * @file           : main.c
  * @brief          : Main program body
  ******************************************************************************
  * @attention
  *
  * Copyright (c) 2025 STMicroelectronics.
  * All rights reserved.
  *
  * This software is licensed under terms that can be found in the LICENSE file
  * in the root directory of this software component.
  * If no LICENSE file comes with this software, it is provided AS-IS.
  *
  ******************************************************************************
  */
/* USER CODE END Header */
#include "main.h"
#include "cmsis_os.h"
#include "BMP180.h"
#include "UART.h"
#include "Interrupt.h"
#include <stdio.h>

osThreadId SensorTaskHandle;
/* USER CODE BEGIN PV */
osThreadId SenDataTaskHandle;
/* USER CODE END PV */

void SystemClock_Config(void);
static void MX_GPIO_Init(void);
void ReadSensorTask(void const * argument);

/* USER CODE BEGIN PFP */
void SendDataTask(void const * argument);
/* USER CODE END PFP */

/* USER CODE BEGIN 0 */
volatile int32_t global_temp = 0;
#define BUFFSIZE	50
char buff[BUFFSIZE] = {0};
uint16_t index_data = 0;
uint16_t send_len = 0;
/*
 * @brief: Hàm handler xử lý ngắt
 * @brief: Bất kì sự kiện INT nào liên quan đến uart1, nó đều nhảy vào đây
 * @param: void
 * @retval: void
 */
void USART1_IRQHandler(void)
{
	// Nếu thanh DR trống
	if(UART1xRS485->SR & UART1xRS485_TXE)
	{
		// Gửi tiếp nếu còn data cần gửi
		///
		if(index_data < send_len)
		{
			UART1xRS485->DR = buff[index_data];
			index_data++;
		}
		else
		{
			UART1xRS485->CR1 &= ~(UART1xRS485_TXEIE);		// Gửi xong thì tắt ngắt
			index_data = 0;				// Reset index
		}
	}
}
/*
 * @brief: Hàm gửi 1 chuỗi, hàm này sẽ write kí tự đầu tiên vào DR reg
 * 		   Sau đó sẽ gửi cho tới khi hết chuỗi bằng ngắt TX
 * 		   Ngắt TX xảy ra khi thanh ghi DR trống
 * @param: data - pointer tới chuỗi cần gửi
 * @param: size - kích cỡ của chuỗi cần gửi
 * @retval: void
 */
void sendData(uint8_t* data, uint16_t size)
{
	// Lưu data vào buff tạm
	for(uint8_t i = 0; i < size; i++)
	{
		buff[i] = data[i];
	}
	send_len = size;
	index_data = 1;
	// Kích chạy lần đầu
	UART1xRS485->DR = buff[0];
	// Set bit TX interrupt enable
	UART1xRS485->CR1 |= UART1xRS485_TXEIE;
}
/* USER CODE END 0 */

int main(void)
{

  /* MCU Configuration--------------------------------------------------------*/

  /* Reset of all peripherals, Initializes the Flash interface and the Systick. */
  HAL_Init();

  /* Configure the system clock */
  SystemClock_Config();

  /* Initialize all configured peripherals */
  MX_GPIO_Init();
  /* USER CODE BEGIN 2 */
  UART1xRS485_init();
  BMP180_I2C1_MasterConfig();
  NVIC_Enable_IRQ(37); // USART1
  /* USER CODE END 2 */

  /* Create the thread(s) */
  /* definition and creation of SensorTask */
  osThreadDef(SensorTask, ReadSensorTask, osPriorityNormal, 0, 128);
  SensorTaskHandle = osThreadCreate(osThread(SensorTask), NULL);

  /* USER CODE BEGIN RTOS_THREADS */
  osThreadDef(DataTask, SendDataTask, osPriorityNormal, 0, 128);
  SenDataTaskHandle = osThreadCreate(osThread(DataTask), NULL);
  /* add threads, ... */
  /* USER CODE END RTOS_THREADS */

  /* Start scheduler */
  osKernelStart();

  /* We should never get here as control is now taken by the scheduler */

  /* Infinite loop */
  while (1)
  {

  }
}

void SystemClock_Config(void)
{
  RCC_OscInitTypeDef RCC_OscInitStruct = {0};
  RCC_ClkInitTypeDef RCC_ClkInitStruct = {0};

  /** Initializes the RCC Oscillators according to the specified parameters
  * in the RCC_OscInitTypeDef structure.
  */
  RCC_OscInitStruct.OscillatorType = RCC_OSCILLATORTYPE_HSI;
  RCC_OscInitStruct.HSIState = RCC_HSI_ON;
  RCC_OscInitStruct.HSICalibrationValue = RCC_HSICALIBRATION_DEFAULT;
  RCC_OscInitStruct.PLL.PLLState = RCC_PLL_NONE;
  if (HAL_RCC_OscConfig(&RCC_OscInitStruct) != HAL_OK)
  {
    Error_Handler();
  }

  /** Initializes the CPU, AHB and APB buses clocks
  */
  RCC_ClkInitStruct.ClockType = RCC_CLOCKTYPE_HCLK|RCC_CLOCKTYPE_SYSCLK
                              |RCC_CLOCKTYPE_PCLK1|RCC_CLOCKTYPE_PCLK2;
  RCC_ClkInitStruct.SYSCLKSource = RCC_SYSCLKSOURCE_HSI;
  RCC_ClkInitStruct.AHBCLKDivider = RCC_SYSCLK_DIV1;
  RCC_ClkInitStruct.APB1CLKDivider = RCC_HCLK_DIV1;
  RCC_ClkInitStruct.APB2CLKDivider = RCC_HCLK_DIV1;

  if (HAL_RCC_ClockConfig(&RCC_ClkInitStruct, FLASH_LATENCY_0) != HAL_OK)
  {
    Error_Handler();
  }
}

static void MX_GPIO_Init(void)
{

  /* GPIO Ports Clock Enable */
  __HAL_RCC_GPIOD_CLK_ENABLE();
  __HAL_RCC_GPIOA_CLK_ENABLE();

}

/* USER CODE BEGIN 4 */

void SendDataTask(void const * argument)
{

	char buffer[32];
	for(;;)
	{
		int32_t temp = global_temp;
		uint16_t len = sprintf(buffer, "Temp = %ld\n", temp);
		sendData(buffer, len);
		osDelay(500);
	}
}

/* USER CODE END 4 */

void ReadSensorTask(void const * argument)
{
  /* USER CODE BEGIN 5 */
  /* Infinite loop */
	uint16_t RawTemp, RawPres, AC6, AC5;
	int16_t MC, MD;
	int32_t X1, X2, B5, T;
	uint8_t ID;
	// READ calib inf from EEPROM
	AC5 = BMP180_I2C1_Read16(0x77, 0xB2);
	AC6 = BMP180_I2C1_Read16(0x77, 0xB4);
	MC = BMP180_I2C1_Read16(0x77, 0xBC);
	MD = BMP180_I2C1_Read16(0x77, 0xBE);
	for(;;)
	{
		// READ ID
		ID = BMP180_I2C1_Read8(0x77, 0xD0);

		//TEMPERATURE
		// Request Temp
		BMP180_I2C1_Write8(0x77, 0xF4, 0x2E);
		// Wait at least 4.5ms
		osDelay(5);
		// Read Temp
		RawTemp = BMP180_I2C1_Read16(0x77, 0xF6);
		// Cal
		X1 = ((RawTemp - (int32_t)AC6) * (int32_t)AC5) >> 15;
		X2 = ((int32_t)MC << 11) / (X1 + MD);
		B5 = X1 + X2;
		// đơn vị: 0.1 °C
		T = (B5 + 8) >> 4;
		global_temp = T;
		osDelay(500);
	}
  /* USER CODE END 5 */
}

void Error_Handler(void)
{
  __disable_irq();
  while (1)
  {
  }
}
